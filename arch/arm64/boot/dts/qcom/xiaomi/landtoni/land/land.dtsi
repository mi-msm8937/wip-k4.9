#include "pinctrl.dtsi"

#include "audio.dtsi"
#include "battery.dtsi"
#include "camera-sensor.dtsi"
#include "display.dtsi"
#include "misc.dtsi"
#include "pm.dtsi"
#include "soc.dtsi"
#include "touchscreen.dtsi"
