/* FROM: wt88537_64.dts */
/ {
	qrd_batterydata: qcom,battery-data {
		qcom,batt-id-range-pct = <15>;
		#include "batterydata/batterydata-qrd-Desay-4v4-4000mah.dtsi"
		#include "batterydata/batterydata-qrd-Atl-4v4-4000mah.dtsi"
		#include "batterydata/batterydata-qrd-Coslight-4v4-4000mah.dtsi"
		#include "batterydata/batterydata-qrd-feimaotui-4v4-4000mah.dtsi"
	};
};

&qpnp_smbcharger {
	qcom,battery-data = <&qrd_batterydata>;
};

&qpnp_fg {
	qcom,battery-data = <&qrd_batterydata>;
};

&qpnp_smbcharger {
	qcom,thermal-mitigation = <2000 1500 1200 800 800>;
};

&qpnp_fg {
	qcom,cool-bat-decidegc = <(100)>;
	qcom,hot-bat-decidegc = <600>;
	qcom,fg-iterm-ma = <200>;
	qcom,fg-chg-iterm-ma = <150>;
	qcom,fg-cutoff-voltage-mv = <3500>;
};
