#include "pinctrl.dtsi"

#include "audio.dtsi"
#include "battery.dtsi"
#include "display.dtsi"
#include "fingerprint.dtsi"
#include "misc.dtsi"
#include "pm.dtsi"
#include "sdhc.dtsi"
#include "soc.dtsi"
