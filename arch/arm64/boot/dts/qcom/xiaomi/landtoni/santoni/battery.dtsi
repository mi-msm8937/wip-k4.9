/* FROM: S88536AA2.dts */
/ {
	qrd_batterydata: qcom,battery-data {
		qcom,batt-id-range-pct = <15>;
		#include "batterydata/batterydata-qrd-Desay-4v4-4100mah.dtsi"
		#include "batterydata/batterydata-qrd-Atl-4v4-4100mah.dtsi"
		#include "batterydata/batterydata-qrd-Coslight-4v4-4100mah.dtsi"
		#include "batterydata/batterydata-qrd-Default-4v4-4100mah.dtsi"
	};
};

&qpnp_smbcharger {
	qcom,battery-data = <&qrd_batterydata>;
};

&qpnp_fg {
	qcom,battery-data = <&qrd_batterydata>;
};

&qpnp_smbcharger {
	qcom,thermal-mitigation = <2000 1500 1200 700 0>;
	qcom,chg-inhibit-fg;
	qcom,vchg_sns-vadc = <&pmi8950_vadc>;
	qcom,vchg-adc-channel-id = <3>;
};

&qpnp_fg {
	qcom,cool-bat-decidegc = <(150)>;
	qcom,hot-bat-decidegc = <550>;
	qcom,fg-iterm-ma = <180>;
	qcom,fg-chg-iterm-ma = <130>;
	qcom,fg-cutoff-voltage-mv = <3400>;
	qcom,resume-soc-raw = <253>;
	qcom,vbat-estimate-diff-mv = <100>;
	qcom,thermal-coefficients = [B7 85 B2 49 71 35];
};
