#include "panels/dsi_hx8394f_boe_720p_video.dtsi"
#include "panels/dsi_nt35521s_ctc_720p_video.dtsi"
#include "panels/dsi_ili9881c_tianma_720p_video.dtsi"

&mdss_dsi0 {
	qcom,dsi-pref-prim-pan = <&dsi_hx8394f_boe_720p_video>;
	qcom,dsi-pref-sub-pan = <&dsi_nt35521s_ctc_720p_video>;
	qcom,dsi-pref-sub1-pan = <&dsi_ili9881c_tianma_720p_video>;
};
