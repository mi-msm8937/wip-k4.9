## drivers/input/fingerprint/Kconfig
```kconfig
menu "Fingerprint Drivers"

source "drivers/input/fingerprint/fpc/Kconfig"
source "drivers/input/fingerprint/goodix/Kconfig"

endmenu
```

## drivers/platform/xiaomi/Kconfig
```kconfig
menuconfig MACH_XIAOMI
	bool "Xiaomi devices"

if MACH_XIAOMI

config MACH_XIAOMI_ROVA
	bool "ROVA"
	help
	  ROVA

config MACH_XIAOMI_ULYSSE
	bool "Xiaomi Redmi Note 5A (Unified)"
	help
	  Support for Xiaomi Redmi Note 5A (Unified).

endif
```
